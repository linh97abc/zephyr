## boards/arm/stm32f4_custom/Kconfig.defconfig
```kconfig
# STM32F4DISCOVERY board configuration

# Copyright (c) 2016 Linaro Limited.
# SPDX-License-Identifier: Apache-2.0

if BOARD_STM32F4_CUSTOM

config BOARD
	default "stm32f4_custom"

if NETWORKING

	config NET_L2_ETHERNET
	default y

	# Required to satisfy dependency of networking stack on RNG
	config TEST_RANDOM_GENERATOR
	default y
endif

endif # BOARD_STM32F4_CUSTOM
```

## boards/st/stm32f4_custom/Kconfig.stm32f4_custom
```kconfig
# Copyright (c) 2016 Linaro Limited.
# SPDX-License-Identifier: Apache-2.0

config BOARD_STM32F4_CUSTOM
	bool "STM32F4DISCOVERY Custom for w5500 Eth"
	select SOC_STM32F407XG

if NETWORKING

	config NET_L2_ETHERNET
	default y

	# Required to satisfy dependency of networking stack on RNG
	config TEST_RANDOM_GENERATOR
	default y
endif
```
